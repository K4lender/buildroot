## configs/t3_gem_o1_defconfig
```kconfig
BR2_aarch64=y
BR2_cortex_a53=y
BR2_ROOTFS_POST_IMAGE_SCRIPT="board/t3/t3-gem-o1/post-image.sh"
BR2_LINUX_KERNEL=y
BR2_LINUX_KERNEL_CUSTOM_GIT=y
BR2_LINUX_KERNEL_CUSTOM_REPO_URL="https://github.com/t3gemstone/linux.git"
BR2_LINUX_KERNEL_CUSTOM_REPO_VERSION="02ecef0cb08a6bd123a4f035a296bc824bcfe5b4"
BR2_LINUX_KERNEL_USE_ARCH_DEFAULT_CONFIG=y
BR2_LINUX_KERNEL_DTS_SUPPORT=y
BR2_LINUX_KERNEL_INTREE_DTS_NAME="ti/k3-am67a-t3-gem-o1"
BR2_LINUX_KERNEL_INSTALL_TARGET=y
BR2_LINUX_KERNEL_NEEDS_HOST_OPENSSL=y
BR2_KERNEL_HEADERS_AS_KERNEL=y
BR2_PACKAGE_HOST_LINUX_HEADERS_CUSTOM_6_12=y
BR2_TARGET_TI_K3_R5_LOADER=y
BR2_TARGET_TI_K3_R5_LOADER_CUSTOM_GIT=y
BR2_TARGET_TI_K3_R5_LOADER_CUSTOM_REPO_URL="https://github.com/t3gemstone/u-boot.git"
BR2_TARGET_TI_K3_R5_LOADER_CUSTOM_REPO_VERSION="8b5ae72c281207430fcc58031fe36f40900f7a2d"
BR2_TARGET_TI_K3_R5_LOADER_BOARD_DEFCONFIG="am67a_t3_gem_o1_r5"
BR2_TARGET_TI_K3_R5_LOADER_USE_DEFCONFIG=y
BR2_TARGET_UBOOT=y
BR2_TARGET_UBOOT_BUILD_SYSTEM_KCONFIG=y
BR2_TARGET_UBOOT_CUSTOM_GIT=y
BR2_TARGET_UBOOT_CUSTOM_REPO_URL="https://github.com/t3gemstone/u-boot.git"
BR2_TARGET_UBOOT_CUSTOM_REPO_VERSION="8b5ae72c281207430fcc58031fe36f40900f7a2d"
BR2_TARGET_UBOOT_BOARD_DEFCONFIG="am67a_t3_gem_o1_a53"
BR2_TARGET_UBOOT_NEEDS_PYTHON3=y
BR2_TARGET_UBOOT_NEEDS_PYLIBFDT=y
BR2_TARGET_UBOOT_NEEDS_OPENSSL=y
BR2_TARGET_UBOOT_NEEDS_GNUTLS=y
BR2_TARGET_UBOOT_NEEDS_ATF_BL31=y
BR2_TARGET_UBOOT_NEEDS_OPTEE_TEE=y
BR2_TARGET_UBOOT_NEEDS_OPTEE_TEE_RAW_BIN=y
BR2_TARGET_TI_K3_BOOT_FIRMWARE=y
BR2_TARGET_ARM_TRUSTED_FIRMWARE=y
BR2_TARGET_ARM_TRUSTED_FIRMWARE_CUSTOM_VERSION=y
BR2_TARGET_ARM_TRUSTED_FIRMWARE_CUSTOM_VERSION_VALUE="v2.10"
BR2_TARGET_ARM_TRUSTED_FIRMWARE_PLATFORM="k3"
BR2_TARGET_ARM_TRUSTED_FIRMWARE_TARGET_BOARD="lite"
BR2_TARGET_OPTEE_OS=y
BR2_TARGET_OPTEE_OS_PLATFORM="k3-am62x"
BR2_TARGET_ROOTFS_EXT2=y
BR2_TARGET_ROOTFS_EXT2_4=y
BR2_TARGET_ROOTFS_EXT2_SIZE="256M"
BR2_PACKAGE_HOST_GENIMAGE=y
BR2_PACKAGE_HOST_DOSFSTOOLS=y
BR2_PACKAGE_HOST_MTOOLS=y
BR2_GLOBAL_PATCH_DIR="board/t3/t3-gem-o1/patches"
BR2_TARGET_UBOOT_CUSTOM_MAKEOPTS="BINMAN_INDIRS=$(BINARIES_DIR) TEE=$(BINARIES_DIR)/tee-pager_v2.bin"
BR2_PACKAGE_E2FSPROGS=y
BR2_PACKAGE_E2FSPROGS_RESIZE2FS=y
BR2_PACKAGE_PARTED=y
BR2_ROOTFS_OVERLAY="board/t3/t3-gem-o1/rootfs_overlay"
```
